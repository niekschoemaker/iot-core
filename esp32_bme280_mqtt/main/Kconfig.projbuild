## esp32_bme280_mqtt/main/Kconfig.projbuild
```kconfig
menu "MQTT Application example"

config WIFI_SSID
    string "WiFi SSID"
    default "myssid"
    help
        SSID (network name) for the example to connect to.

config WIFI_PASSWORD
    string "WiFi Password"
    default "mypassword"
    help
        WiFi password (WPA or WPA2) for the example to use.

config EMITTER_CHANNEL_KEY
    string "Emitter channel key"
    default ""
    help
        The Emitter channel key using to pub/sub

config MQTT_URL
    string "MQTT broker url"
    default ""
    help
        The URL/IP where the MQTT broker was running

config DEVICE_ID
    string "Device ID"
    default "1"
    help
        Device ID used to identify the device in the MQTT messages


endmenu
```
